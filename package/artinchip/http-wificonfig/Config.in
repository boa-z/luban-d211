## package/artinchip/http-wificonfig/Config.in
```kconfig
config BR2_PACKAGE_HTTP_WIFICONFIG
    bool "Enable artinchip http-wificonfig"
    default n
```

## package/artinchip/test-adc/Config.in
```kconfig
menuconfig BR2_PACKAGE_TEST_ADC
	bool "test-adc"
	default y

if BR2_PACKAGE_TEST_ADC
config BR2_PACKAGE_TEST_ADC_USE_PREBUILT
	bool "use prebuilt binary instead of building from source"
	default n
endif
```

## package/artinchip/test-battery/Config.in
```kconfig
menuconfig BR2_PACKAGE_TEST_BATTERY
	bool "test-battery"
	default n

if BR2_PACKAGE_TEST_BATTERY
config BR2_PACKAGE_TEST_BATTERY_USE_PREBUILT
	bool "use prebuilt binary instead of building from source"
	default n
endif
```

## source/linux-5.10/arch/riscv/configs/d211_aishoot88_nor_defconfig
```kconfig
CONFIG_DEFAULT_HOSTNAME="ArtInChip"
CONFIG_SYSVIPC=y
CONFIG_NO_HZ_IDLE=y
CONFIG_HIGH_RES_TIMERS=y
CONFIG_IKCONFIG=y
CONFIG_IKCONFIG_PROC=y
CONFIG_CGROUPS=y
CONFIG_CGROUP_SCHED=y
CONFIG_CFS_BANDWIDTH=y
CONFIG_CGROUP_BPF=y
CONFIG_NAMESPACES=y
CONFIG_USER_NS=y
CONFIG_CHECKPOINT_RESTORE=y
CONFIG_EXPERT=y
CONFIG_BPF_SYSCALL=y
CONFIG_FORCE_MAX_ZONEORDER=11
CONFIG_ARCH_ARTINCHIP=y
CONFIG_CMODEL_MEDLOW=y
CONFIG_HZ_100=y
# CONFIG_EFI is not set
CONFIG_CPU_FREQ=y
CONFIG_CPU_FREQ_STAT=y
CONFIG_CPU_FREQ_DEFAULT_GOV_ONDEMAND=y
CONFIG_CPUFREQ_DT=y
CONFIG_CPU_IDLE=y
CONFIG_RISCV_CPUIDLE=y
# CONFIG_STRICT_KERNEL_RWX is not set
CONFIG_MODULES=y
CONFIG_MODULE_UNLOAD=y
CONFIG_CMA=y
CONFIG_NET=y
CONFIG_PACKET=y
CONFIG_UNIX=y
CONFIG_INET=y
# CONFIG_IPV6 is not set
CONFIG_DNS_RESOLVER=y
CONFIG_NETLINK_DIAG=y
CONFIG_BT=y
CONFIG_BT_HCIBTUSB=y
CONFIG_BT_HCIBTUSB_RTLBTUSB=y
CONFIG_CFG80211=y
CONFIG_CFG80211_WEXT=y
CONFIG_MAC80211=y
CONFIG_RFKILL=y
CONFIG_RFKILL_INPUT=y
CONFIG_RFKILL_GPIO=y
# CONFIG_ETHTOOL_NETLINK is not set
CONFIG_DEVTMPFS=y
CONFIG_DEVTMPFS_MOUNT=y
CONFIG_MTD=y
CONFIG_MTD_CMDLINE_PARTS=y
CONFIG_MTD_BLOCK=y
CONFIG_MTD_SPI_NOR=y
# CONFIG_MTD_SPI_NOR_USE_4K_SECTORS is not set
CONFIG_BLK_DEV_LOOP=y
CONFIG_BLK_DEV_LOOP_MIN_COUNT=2
CONFIG_BLK_DEV_RAM=y
CONFIG_BLK_DEV_RAM_COUNT=1
CONFIG_ARTINCHIP_ADCIM=y
CONFIG_ARTINCHIP_SYSCFG=y
CONFIG_ARTINCHIP_WRI=y
CONFIG_NETDEVICES=y
# CONFIG_ETHERNET is not set
# CONFIG_USB_NET_DRIVERS is not set
# CONFIG_WLAN_VENDOR_ADMTEK is not set
# CONFIG_WLAN_VENDOR_ATH is not set
# CONFIG_WLAN_VENDOR_ATMEL is not set
# CONFIG_WLAN_VENDOR_BROADCOM is not set
# CONFIG_WLAN_VENDOR_CISCO is not set
# CONFIG_WLAN_VENDOR_INTEL is not set
# CONFIG_WLAN_VENDOR_INTERSIL is not set
# CONFIG_WLAN_VENDOR_MARVELL is not set
# CONFIG_WLAN_VENDOR_MEDIATEK is not set
# CONFIG_WLAN_VENDOR_MICROCHIP is not set
# CONFIG_WLAN_VENDOR_RALINK is not set
CONFIG_RTL8733BU=y
# CONFIG_WLAN_VENDOR_RSI is not set
# CONFIG_WLAN_VENDOR_ST is not set
# CONFIG_WLAN_VENDOR_TI is not set
# CONFIG_WLAN_VENDOR_ZYDAS is not set
# CONFIG_WLAN_VENDOR_QUANTENNA is not set
CONFIG_INPUT_EVDEV=y
CONFIG_KEYBOARD_GPIO=y
# CONFIG_INPUT_MOUSE is not set
# CONFIG_LEGACY_PTYS is not set
CONFIG_SERIAL_8250=y
# CONFIG_SERIAL_8250_DEPRECATED_OPTIONS is not set
CONFIG_SERIAL_8250_CONSOLE=y
CONFIG_SERIAL_8250_NR_UARTS=8
CONFIG_SERIAL_8250_RUNTIME_UARTS=8
CONFIG_SERIAL_8250_DW=y
CONFIG_SERIAL_EARLYCON_RISCV_SBI=y
CONFIG_HVC_RISCV_SBI=y
CONFIG_HW_RANDOM=y
CONFIG_I2C=y
CONFIG_I2C_CHARDEV=y
CONFIG_I2C_ARTINCHIP=y
CONFIG_SPI=y
CONFIG_SPI_ARTINCHIP=y
CONFIG_PINCTRL=y
CONFIG_PINCTRL_ARTINCHIP_V1=y
# CONFIG_HWMON is not set
CONFIG_THERMAL=y
CONFIG_WATCHDOG=y
CONFIG_ARTINCHIP_WATCHDOG=y
CONFIG_FB=y
CONFIG_BACKLIGHT_CLASS_DEVICE=y
CONFIG_BACKLIGHT_PWM=y
CONFIG_BACKLIGHT_GPIO=y
CONFIG_ARTINCHIP_GE=y
CONFIG_ARTINCHIP_VE=y
CONFIG_ARTINCHIP_FB=y
CONFIG_AIC_DISP_MIPI_DSI=y
CONFIG_AIC_PANEL_DSI_NV3051=y
CONFIG_USB=y
CONFIG_USB_EHCI_HCD=y
# CONFIG_USB_EHCI_TT_NEWSCHED is not set
CONFIG_USB_EHCI_HCD_AIC=y
CONFIG_USB_OHCI_HCD=y
CONFIG_USB_OHCI_HCD_AIC=y
CONFIG_USB_GADGET=y
CONFIG_USB_AIC_UDC=y
CONFIG_USB_CONFIGFS=y
CONFIG_USB_CONFIGFS_ACM=y
CONFIG_USB_CONFIGFS_OBEX=y
CONFIG_USB_CONFIGFS_NCM=y
CONFIG_USB_CONFIGFS_ECM=y
CONFIG_USB_CONFIGFS_ECM_SUBSET=y
CONFIG_USB_CONFIGFS_RNDIS=y
CONFIG_USB_CONFIGFS_EEM=y
CONFIG_USB_CONFIGFS_MASS_STORAGE=y
CONFIG_USB_CONFIGFS_F_LB_SS=y
CONFIG_USB_CONFIGFS_F_FS=y
CONFIG_RTC_CLASS=y
CONFIG_RTC_DRV_ARTINCHIP=y
CONFIG_DMADEVICES=y
CONFIG_ARTINCHIP_DMA=y
CONFIG_ARTINCHIP_DDMA=y
CONFIG_SYNC_FILE=y
CONFIG_SW_SYNC=y
CONFIG_DMABUF_HEAPS=y
CONFIG_DMABUF_HEAPS_CMA=y
CONFIG_DMABUF_HEAPS_MPP=y
# CONFIG_VIRTIO_MENU is not set
# CONFIG_VHOST_MENU is not set
CONFIG_PM_DEVFREQ=y
CONFIG_ARTINCHIP_BUS_DEVFREQ=y
CONFIG_IIO=y
CONFIG_ARTINCHIP_GPAI=y
CONFIG_PWM=y
CONFIG_PWM_ARTINCHIP=y
CONFIG_SIFIVE_PLIC=y
CONFIG_RESET_CONTROLLER=y
CONFIG_ARTINCHIP_SID=y
# CONFIG_FILE_LOCKING is not set
CONFIG_MSDOS_FS=y
CONFIG_VFAT_FS=y
CONFIG_TMPFS=y
CONFIG_TMPFS_POSIX_ACL=y
CONFIG_JFFS2_FS=y
CONFIG_JFFS2_FS_WBUF_VERIFY=y
CONFIG_JFFS2_SUMMARY=y
CONFIG_JFFS2_FS_XATTR=y
CONFIG_JFFS2_COMPRESSION_OPTIONS=y
CONFIG_JFFS2_LZO=y
CONFIG_JFFS2_RUBIN=y
CONFIG_SQUASHFS=y
CONFIG_SQUASHFS_XATTR=y
CONFIG_SQUASHFS_LZ4=y
CONFIG_SQUASHFS_LZO=y
CONFIG_SQUASHFS_XZ=y
CONFIG_SQUASHFS_ZSTD=y
# CONFIG_NETWORK_FILESYSTEMS is not set
CONFIG_NLS_CODEPAGE_936=y
CONFIG_CRYPTO_USER=y
CONFIG_CRYPTO_DEFLATE=y
CONFIG_CRYPTO_LZO=y
CONFIG_CRYPTO_ZSTD=y
CONFIG_CRYPTO_USER_API_HASH=y
CONFIG_CRYPTO_USER_API_SKCIPHER=y
CONFIG_CRYPTO_USER_API_RNG=y
CONFIG_CRYPTO_USER_API_AEAD=y
CONFIG_CRYPTO_STATS=y
CONFIG_CRYPTO_USER_API_AKCIPHER=y
CONFIG_CRYPTO_DEV_ARTINCHIP_CE=y
CONFIG_DMA_CMA=y
CONFIG_PRINTK_TIME=y
CONFIG_DEBUG_INFO=y
CONFIG_DEBUG_FS=y
# CONFIG_DEBUG_MISC is not set
```

## source/linux-5.10/drivers/video/artinchip/disp/Kconfig
```kconfig
# SPDX-License-Identifier: GPL-2.0-only
config ARTINCHIP_FB
	tristate "ArtInChip Framebuffer support"
	depends on FB
	select VIDEOMODE_HELPERS
	select FB_CFB_FILLRECT
	select FB_CFB_COPYAREA
	select FB_CFB_IMAGEBLIT
	default n
	help
          This is the driver for the ArtInChip DE, the driver is based on
	  Linux framebuffer.

config AIC_DISP_RGB
	bool "ArtInChip display rgb support"
	depends on ARTINCHIP_FB
	default n
	help
	  ArtInChip display rgb support

config AIC_DISP_LVDS
	bool "ArtInChip display lvds support"
	depends on ARTINCHIP_FB
	default n
	help
	  ArtInChip display lvds support

config AIC_DISP_MIPI_DSI
	bool "ArtInChip display mipi-dsi support"
	depends on ARTINCHIP_FB
	default n
	help
	  ArtInChip display mipi-dsi support

config AIC_DISP_MIPI_DSI_V1_0
	bool
	default y
	depends on AIC_DISP_MIPI_DSI && RISCV
	help
	  ArtInChip display mipi-dsi v1.0

config AIC_DISP_MIPI_DBI
	bool "ArtInChip display mipi-dbi support"
	depends on ARTINCHIP_FB
	default n
	help
	  ArtInChip display mipi-dbi support

config AIC_DSI_LEGACY_PACKET_CONFIG
	bool "enable MIPI-DSI legacy packet config"
	depends on AIC_DISP_MIPI_DSI
	default n
	help
	  Choose this option if you have a need for the legacy luban
	  sdk version support. If in doubt, say "N".

if ARTINCHIP_FB
source "drivers/video/artinchip/disp/panel/Kconfig"
endif
```

## target/configs/d211_aishoot88_nor_defconfig
```kconfig
LUBAN_BOARD_D211_AISHOOT88_NOR=y
BR2_TOOLCHAIN_EXTERNAL_URL="toolchain/riscv64-linux-glibc-x86_64-V2.10.1.tar.gz"
BR2_TOOLCHAIN_EXTERNAL_CUSTOM_PREFIX="riscv64-unknown-linux-gnu"
BR2_TOOLCHAIN_EXTERNAL_GCC_10=y
BR2_TOOLCHAIN_EXTERNAL_CUSTOM_GLIBC=y
# BR2_TOOLCHAIN_EXTERNAL_INET_RPC is not set
BR2_TARGET_GENERIC_HOSTNAME="aishoot88_nor"
BR2_TARGET_GENERIC_ISSUE="Welcome to aic linux"
# BR2_TARGET_ENABLE_ROOT_LOGIN is not set
BR2_TARGET_TZ_INFO=y
BR2_TARGET_LOCALTIME="Asia/Shanghai"
BR2_ROOTFS_POST_IMAGE_SCRIPT="target/d211/common/post-image.sh"
# BR2_TARGET_GENERIC_GETTY is not set
BR2_ROOTFS_DEVICE_CREATION_DYNAMIC_MDEV=y
BR2_TARGET_GENERIC_REMOUNT_ROOTFS_RW=y
BR2_SYSTEM_DEFAULT_PATH="/bin:/sbin:/usr/bin:/usr/sbin:/usr/local/bin"
BR2_TARGET_ROOTFS_SQUASHFS=y
BR2_TARGET_ROOTFS_SQUASHFS4_XZ=y
# BR2_TARGET_ROOTFS_TAR is not set
BR2_TARGET_USERFS1=y
BR2_TARGET_USERFS1_TYPE_SQUASHFS=y
BR2_TARGET_USERFS1_SQUASHFS4_XZ=y
BR2_TARGET_USERFS1_OVERLAY="target/$(LUBAN_CHIP_NAME)/$(LUBAN_BOARD_NAME)/ota"
BR2_PACKAGE_OPENSBI_FW_TEXT_BASE=0x43FE0000
BR2_TARGET_UBOOT_BOARD_DEFCONFIG="d211_aishoot88_nor"
BR2_TARGET_UBOOT_NEEDS_PYTHON3=y
BR2_TARGET_UBOOT_FORMAT_DTB=y
BR2_TARGET_UBOOT_FORMAT_DTB_BIN=y
BR2_TARGET_UBOOT_FORMAT_NODTB_BIN=y
BR2_TARGET_UBOOT_FORMAT_IMG=y
BR2_TARGET_UBOOT_FORMAT_DTB_IMG=y
BR2_TARGET_UBOOT_FORMAT_CUSTOM=y
BR2_TARGET_UBOOT_FORMAT_CUSTOM_NAME="u-boot.its"
BR2_TARGET_UBOOT_SPL=y
BR2_TARGET_UBOOT_SPL_NAME="spl/u-boot-spl-dtb.bin"
BR2_LINUX_KERNEL_CUSTOM_VERSION_VALUE="5.10"
BR2_LINUX_KERNEL_DEFCONFIG="d211_aishoot88_nor"
BR2_LINUX_KERNEL_IMAGEGZ=y
BR2_PACKAGE_LINUX_TOOLS_IIO=y
# BR2_PACKAGE_OPENSSL_HWENGINE is not set
# BR2_PACKAGE_AIC_AUTHORIZATION is not set
# BR2_PACKAGE_AIC_MPP_MIDDLEWARE is not set
# BR2_PACKAGE_AIC_LOGO is not set
# BR2_PACKAGE_LIBUSERID is not set
# BR2_PACKAGE_AICP_DEC is not set
# BR2_PACKAGE_TEST_ADC is not set
# BR2_PACKAGE_TEST_MTOP is not set
# BR2_PACKAGE_TEST_CE is not set
# BR2_PACKAGE_TEST_DMA_BUF is not set
# BR2_PACKAGE_TEST_DVP is not set
# BR2_PACKAGE_TEST_FB is not set
# BR2_PACKAGE_TEST_TOUCHSCREEN is not set
# BR2_PACKAGE_TEST_UART is not set
# BR2_PACKAGE_TEST_WATCHDOG is not set
# BR2_PACKAGE_TEST_CLOCK is not set
# BR2_PACKAGE_TEST_KEYADC is not set
# BR2_PACKAGE_REG_DUMP is not set
# BR2_PACKAGE_TEST_GPIO is not set
# BR2_PACKAGE_TEST_CAN is not set
# BR2_PACKAGE_TEST_ETH is not set
# BR2_PACKAGE_TEST_AUDIO is not set
# BR2_PACKAGE_TEST_BLKDEV is not set
# BR2_PACKAGE_TEST_EFUSE is not set
# BR2_PACKAGE_TEST_COREDUMP is not set
BR2_PACKAGE_BUSYBOX_CONFIG="package/third-party/busybox/configs/riscv64_linux_defconfig"
BR2_PACKAGE_FREETYPE=y
BR2_PACKAGE_WPA_SUPPLICANT=y
BR2_PACKAGE_WIRELESS_TOOLS=y
BR2_PACKAGE_BLUEZ5_UTILS_HEADERS=y
BR2_PACKAGE_BLUEZ5_UTILS=y
# BR2_PACKAGE_BLUEZ5_UTILS_USE_PREBUILT is not set
BR2_PACKAGE_BLUEZ5_UTILS_TOOLS=y
BR2_PACKAGE_BLUEZ5_UTILS_DEPRECATED=y
BR2_PACKAGE_BLUEZ_TOOLS=y
# BR2_PACKAGE_DBUS_USE_PREBUILT is not set
# BR2_PACKAGE_UBOOT_TOOLS is not set
BR2_PACKAGE_RTL8733BU_BT_FW=y
# BR2_PACKAGE_HOST_UBOOT_TOOLS is not set
BR2_PACKAGE_HOST_E2FSPROGS=y
BR2_PACKAGE_HOST_ANDROID_TOOLS=y
BR2_PACKAGE_HOST_ANDROID_TOOLS_EXT4_UTILS=y
```
