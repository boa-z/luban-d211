## package/artinchip/aic-cast/Config.in
```kconfig
menuconfig BR2_PACKAGE_AIC_CAST
	bool "aic-cast"
	default n

if BR2_PACKAGE_AIC_CAST
config BR2_PACKAGE_AIC_CASE_ENABLE_AUDIO
	bool "enable audio"
	default n
endif
```

## package/artinchip/aic-mpp/Config.in
```kconfig
menuconfig BR2_PACKAGE_AIC_MPP
	bool "aic-mpp"
	default y

if BR2_PACKAGE_AIC_MPP
config BR2_PACKAGE_AIC_MPP_USE_PREBUILT
	bool "use prebuilt binary instead of building from source"
	default n

choice
	prompt "Render backend type"
	default BR2_PACKAGE_AIC_MPP_RENDER_FBDEV

	config BR2_PACKAGE_AIC_MPP_RENDER_FBDEV
	bool "fbdev backend"

	config BR2_PACKAGE_AIC_MPP_RENDER_DRM
	bool "DRM backend"
endchoice

config BR2_PACKAGE_AIC_MPP_MIDDLEWARE
	select BR2_PACKAGE_LWRB
	bool "enable middle ware"
	default y

config BR2_PACKAGE_AIC_MPP_TEST
	bool "enable mpp test"
	select BR2_PACKAGE_AIC_MPP_MIDDLEWARE
	default n

config BR2_PACKAGE_AIC_MPP_RECORDER
	select BR2_PACKAGE_AIC_MPP_MIDDLEWARE
	select BR2_PACKAGE_AIC_MPP_VIDEO_ENCODER
	select BR2_PACKAGE_AIC_MPP_AUDIO_ENCODER
	select BR2_PACKAGE_AIC_MPP_MP3_ENCODER
	select BR2_PACKAGE_AIC_MPP_MUXER
	select BR2_PACKAGE_SQLITE
	bool "enable recorder"
	default n

menuconfig BR2_PACKAGE_AIC_MPP_VIDEO_DECODER
	bool "enable video decoder"
	select BR2_PACKAGE_AIC_MPP_MIDDLEWARE
	default y

	if BR2_PACKAGE_AIC_MPP_VIDEO_DECODER
	config BR2_PACKAGE_AIC_MPP_MPEG12_DECODER
		bool "enable mpeg12 decoder"
		default n

	config BR2_PACKAGE_AIC_MPP_MPEG4_DECODER
		bool "enable mpeg4 decoder"
		default n
	endif

menuconfig BR2_PACKAGE_AIC_MPP_VIDEO_ENCODER
	bool "enable video encoder"
	select BR2_PACKAGE_AIC_MPP_MIDDLEWARE
	default y

	if BR2_PACKAGE_AIC_MPP_VIDEO_ENCODER
	config BR2_PACKAGE_AIC_MPP_H264_ENCODER
		bool "enable h264 encoder"
		default n
	endif

menuconfig BR2_PACKAGE_AIC_MPP_AUDIO_DECODER
	bool "enable audio decoder"
	select BR2_PACKAGE_AIC_MPP_MIDDLEWARE
	default y

	if BR2_PACKAGE_AIC_MPP_AUDIO_DECODER
	config BR2_PACKAGE_AIC_MPP_AAC_DECODER
		bool "enable aac decoder"
		default n

	config BR2_PACKAGE_AIC_MPP_VORBIS_DECODER
		bool "enable vorbis decoder"
		select BR2_PACKAGE_LIBVORBIS
		select BR2_PACKAGE_LIBOGG
		default n

	config BR2_PACKAGE_AIC_MPP_OPUS_DECODER
		bool "enable opus decoder"
		select BR2_PACKAGE_OPUS
		default n

	config BR2_PACKAGE_AIC_MPP_AAC_ELD_DECODER
		bool "enable aac-eld decoder"
		select BR2_PACKAGE_FDK_AAC
		default n

	config BR2_PACKAGE_AIC_MPP_ALAC_DECODER
		bool "enable alac decoder"
		select BR2_PACKAGE_ALAC
		default n

	config BR2_PACKAGE_AIC_MPP_APE_DECODER
		bool "enable ape decoder"
		default n

	config BR2_PACKAGE_AIC_MPP_FLAC_DECODER
		bool "enable flac decoder"
		default n
	endif

menuconfig BR2_PACKAGE_AIC_MPP_AUDIO_ENCODER
	bool "enable audio encoder"
	select BR2_PACKAGE_AIC_MPP_MIDDLEWARE
	default n

	if BR2_PACKAGE_AIC_MPP_AUDIO_ENCODER
	config BR2_PACKAGE_AIC_MPP_MP3_ENCODER
		bool "enable mp3 encoder"
		select BR2_PACKAGE_LAME
		default n

	config BR2_PACKAGE_AIC_MPP_AAC_ENCODER
		bool "enable aac encoder"
		select BR2_PACKAGE_FDK_AAC
		default n
	endif

menuconfig BR2_PACKAGE_AIC_MPP_DEMUX
	bool "enable demux"
	select BR2_PACKAGE_AIC_MPP_MIDDLEWARE
	default y

	if BR2_PACKAGE_AIC_MPP_DEMUX
	config BR2_PACKAGE_AIC_MPP_WAV_DEMUXER
		bool "enable wav demuxer"
		default n

	config BR2_PACKAGE_AIC_MPP_AVI_DEMUXER
		bool "enable avi demuxer"
		default n

	config BR2_PACKAGE_AIC_MPP_MKV_DEMUXER
		bool "enable mkv demuxer"
		default n

	config BR2_PACKAGE_AIC_MPP_TS_DEMUXER
		bool "enable ts demuxer"
		default n

	config BR2_PACKAGE_AIC_MPP_FLV_DEMUXER
		bool "enable flv demuxer"
		default n

	config BR2_PACKAGE_AIC_MPP_RTSP_DEMUXER
		bool "enable rtsp demuxer"
		default n

	config BR2_PACKAGE_AIC_MPP_HLS_DEMUXER
		bool "enable hls demuxer"
		select BR2_PACKAGE_AIC_MPP_HTTP_STREAM
		select BR2_PACKAGE_AIC_MPP_TS_DEMUXER
		default n

	config BR2_PACKAGE_AIC_MPP_OGG_DEMUXER
		bool "enable ogg/opus demuxer"
		select BR2_PACKAGE_LIBOGG
		default n

	config BR2_PACKAGE_AIC_MPP_MPG_DEMUXER
		bool "enable mpg demuxer"
		default n

	config BR2_PACKAGE_AIC_MPP_PMP_DEMUXER
		bool "enable pmp demuxer"
		default n
	endif

menuconfig BR2_PACKAGE_AIC_MPP_MUXER
	bool "enable muxer"
	select BR2_PACKAGE_AIC_MPP_MIDDLEWARE
	default n

	if BR2_PACKAGE_AIC_MPP_MUXER
	config BR2_PACKAGE_AIC_MPP_MP4_MUXER
		bool "enable mp4 muxer"
		default y

	config BR2_PACKAGE_AIC_MPP_TS_MUXER
		bool "enable ts muxer"
		default n
	endif

menuconfig BR2_PACKAGE_AIC_MPP_STREAM
	bool "enable stream"
	select BR2_PACKAGE_AIC_MPP_MIDDLEWARE
	default y

	if BR2_PACKAGE_AIC_MPP_STREAM
	config BR2_PACKAGE_AIC_MPP_HTTP_STREAM
		bool "enable http stream"
		default n

	menuconfig BR2_PACKAGE_AIC_MPP_RTP_STREAM
		bool "enable rtp stream"
		default n
		if BR2_PACKAGE_AIC_MPP_RTP_STREAM
		config BR2_PACKAGE_AIC_MPP_RTP_ENABLE_SORTER
			depends on BR2_PACKAGE_AIC_MPP_RTP_STREAM
			bool "enable rtp packet sorter"
			default y
		endif
	endif
endif
```

## package/artinchip/selfie/Config.in
```kconfig
menuconfig BR2_PACKAGE_SELFIE
	bool "selfie"
	default n

if BR2_PACKAGE_SELFIE
config BR2_PACKAGE_SELFIE_USE_PREBUILT
	bool "use prebuilt binary instead of building from source"
	default n
endif
```

## package/artinchip/test-i2s/Config.in
```kconfig
menuconfig BR2_PACKAGE_TEST_I2S
	bool "test-i2s"
	default y
	select BR2_PACKAGE_ALSA_LIB

if BR2_PACKAGE_TEST_I2S
config BR2_PACKAGE_TEST_I2S_USE_PREBUILT
	bool "use prebuilt binary instead of building from source"
	default n
endif
```

## package/artinchip/test-vin/Config.in
```kconfig
menuconfig BR2_PACKAGE_TEST_VIN
	bool "test-vin"
	default n
	select BR2_PACKAGE_V4L_UTILS
	select BR2_PACKAGE_LIBDRM
```

## package/third-party/aic8800_fw/Config.in
```kconfig
menuconfig BR2_PACKAGE_AIC8800_FW
	bool "AIC8800 sdio firmware"
	default n

if BR2_PACKAGE_AIC8800_FW

menu "Select supported chip ids"

config AIC8800_FW_ID_AIC8800
	bool "aic8800"
	default y

config AIC8800_FW_ID_AIC8800D80
	bool "aic8800D80"
	default y

config AIC8800_FW_ID_AIC8800D80_MINI
	bool "aic8800D80-mini"
	default y

config AIC8800_FW_ID_AIC8800D80N
	bool "aic8800D80N"
	default y

config AIC8800_FW_ID_AIC8800D80X2
	bool "aic8800D80X2"
	default y

config AIC8800_FW_ID_AIC8800D80DC
	bool "aic8800D80DC"
	default y

endmenu

endif
```

## package/third-party/ape/Config.in
```kconfig
config BR2_PACKAGE_APE
	bool "ape"
	help
	  APE: A lightweight APE decoding library.
```

## package/third-party/fdk-aac/Config.in
```kconfig
# These are the architectures supported by FDK AAC
config BR2_PACKAGE_FDK_AAC
	bool "fdk-aac"
	help
	  The Fraunhofer FDK AAC Codec Library for Android ("FDK AAC
	  Codec") is software that implements the MPEG Advanced Audio
	  Coding ("AAC") encoding and decoding scheme for digital audio

	  http://sourceforge.net/projects/opencore-amr/files/fdk-aac/

comment "fdk-aac needs a toolchain w/ C++"
	depends on BR2_PACKAGE_FDK_AAC_ARCH_SUPPORTS
	depends on !BR2_INSTALL_LIBSTDCPP
```

## package/third-party/flac/Config.in
```kconfig
config BR2_PACKAGE_FLAC
	bool "flac"
	help
	  FLAC is a free lossless audio codec library, supporting encoding,
	  decoding and metadata manipulation of FLAC streams.

	  https://xiph.org/flac/
```

## package/third-party/libev/Config.in
```kconfig
menuconfig BR2_PACKAGE_LIBEV
	bool "libev"
	help
	  Userspace library for handling asynchronous notifications

	  http://software.schmorp.de/pkg/libev.html

if BR2_PACKAGE_LIBEV
config BR2_PACKAGE_LIBEV_USE_PREBUILT
	bool "use prebuilt binary instead of building from source"
	default y
endif
```

## package/third-party/lwrb/Config.in
```kconfig
menuconfig BR2_PACKAGE_LWRB
	bool "lwRB"
	help
	  Library provides generic FIFO ring buffer implementation.

	  https://github.com/MaJerle/lwrb
```

## package/third-party/mhz/Config.in
```kconfig
config BR2_PACKAGE_MHZ
	bool "mhz"
	help
	  CPU frequency measurement utility.

	  https://github.com/wtarreau/mhz.git

if BR2_PACKAGE_MHZ
config BR2_PACKAGE_MHZ_USE_PREBUILT
	depends on BR2_PACKAGE_MHZ
	bool "use prebuilt binary instead of building from source"
	default y
endif

config BR2_PACKAGE_MHZ_STATIC
	bool "Build mhz with static link"
	default n
	depends on BR2_PACKAGE_MHZ && !BR2_PACKAGE_MHZ_USE_PREBUILT
```

## package/third-party/time/Config.in
```kconfig
menuconfig BR2_PACKAGE_TIME
	bool "time"
	depends on BR2_USE_MMU # fork()
	# See https://savannah.gnu.org/bugs/index.php?48000
	depends on !BR2_STATIC_LIBS
	depends on BR2_PACKAGE_BUSYBOX_SHOW_OTHERS
	help
	  The GNU time utility.

	  http://savannah.gnu.org/projects/time/

if BR2_PACKAGE_TIME

config BR2_PACKAGE_TIME_USE_PREBUILT
	bool "use prebuilt binary instead of building from source"
	default y

endif

comment "time needs a toolchain w/ dynamic library"
	depends on BR2_USE_MMU
	depends on BR2_STATIC_LIBS
```

## source/linux-5.10/drivers/net/wireless/aic8800/Kconfig
```kconfig
menuconfig AIC_SDIO_WLAN_SUPPORT
	bool "AIC Sdio wireless Support"
	default n
	help
	  This is support for aic wireless chip (SDIO).

if AIC_SDIO_WLAN_SUPPORT

source "drivers/net/wireless/aic8800/aic8800_fdrv/Kconfig"

if AIC8800_SDIO_WLAN_SUPPORT

config AIC_FW_PATH
	string "Firmware & config file path"
	default "/etc/firmware"
	help
	  Path to the firmware & config file.

config AIC_WLAN_DEBUG
	bool "AIC wireless Debug"
	default n

config RWNX_MON_RXFILTER
	bool "Enable RX filter in monitor mode"
	default n
	help
	  This option enables RX filter functionality when the device is in
	  monitor mode. When enabled, the driver will apply additional filtering
	  rules to received frames, which can help reduce unnecessary processing
	  and improve performance in monitor mode scenarios.
	  If unsure, say N.

endif # AIC8800_SDIO_WLAN_SUPPORT

source "drivers/net/wireless/aic8800/aic8800_btlpm/Kconfig"

endif # AIC_SDIO_WLAN_SUPPORT
```

## source/linux-5.10/drivers/net/wireless/aic8800/aic8800_fdrv/Kconfig
```kconfig
config AIC8800_SDIO_WLAN_SUPPORT
	tristate "AIC8800 wlan Support"
	help
	  This is support for aic wifi driver.

config ONE_TXQ
	bool "Use single netdev TX queue"
	depends on AIC8800_SDIO_WLAN_SUPPORT
	default n
	help
	  Enable single netdev TX queue mode. The driver will select the
	  hardware TX queue internally instead of using the kernel's
	  multi-queue mechanism. Reduces resource usage by allocating
	  fewer TX queues in the firmware.
config RWNX_ROC_DUR_MAX
	int "Maximum Remain on Channel duration (ms)"
	depends on AIC8800_SDIO_WLAN_SUPPORT
	default 500
	range 100 1000
	help
	  Set the maximum duration for remain on channel operation in milliseconds.
```

## source/linux-5.10/drivers/net/wireless/aic8800_usb/Kconfig
```kconfig
menuconfig AIC_USB_WLAN_SUPPORT
	bool "AIC Usb wireless Support"
	default n
	help
	  This is support for aic wireless chip (USB).

if AIC_USB_WLAN_SUPPORT

source "drivers/net/wireless/aic8800_usb/aic8800_fdrv/Kconfig"

if AIC8800_USB_WLAN_SUPPORT

config AIC_FW_PATH
	string "Firmware & config file path"
	default "/etc/firmware"
	help
	  Path to the firmware & config file.

config RWNX_MON_RXFILTER
        bool "Enable RX filter in monitor mode"
        default n
        help
          This option enables RX filter functionality when the device is in
          monitor mode. When enabled, the driver will apply additional filtering
          rules to received frames, which can help reduce unnecessary processing
          and improve performance in monitor mode scenarios.
          If unsure, say N.

endif # AIC8800_USB_WLAN_SUPPORT

source "drivers/net/wireless/aic8800_usb/aic_load_fw/Kconfig"

endif # AIC_USB_WLAN_SUPPORT
```

## source/linux-5.10/drivers/net/wireless/realtek/rtl8733bu_obj_td/Kconfig
```kconfig
config RTL8733BU_OBJ_TD
	depends on USB
	tristate "Realtek 8733B USB WiFi from TD"
	help
	  Realtek RTL8733BU chipset driver
	  802.11ac USB wireless network adapter
```
